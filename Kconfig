## Kconfig
```kconfig
config BYTECHECKER
	bool "ByteChecker"
	default n
	---help---
		Enable bytechecker

if BYTECHECKER

config BYTECHECKER_NUM_OBJECTS
	int "The number of metadata"
	default "10"

config BYTECHECKER_PAGE_SIZE
	int "The size of memory"
	default "1024"

endif
```
